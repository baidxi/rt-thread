SYStem.JtagClock 67MHz
SYStem.cpu CortexA7
SYStem.CONFIG.CTI.Base DAP:0x80050000
SYStem.CONFIG.COREDEBUG.Base DAP:0x81410000
SYStem.CONFIG.BMC.Base DAP:0x81411000
