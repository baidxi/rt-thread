SYStem.JtagClock 60MHz
SYStem.cpu CortexA7MPCore
SYStem.CONFIG CoreNumber 2
SYStem.CONFIG.CORE 2
SYStem.CONFIG.CTI.Base DAP:0x80050000
SYStem.CONFIG.COREDEBUG.Base 0x81410000 0x81420000
SYStem.CONFIG.BMC.Base 0x81411000 0x81413000
CORE.ASSIGN 2 1